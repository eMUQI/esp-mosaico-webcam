## main/Kconfig.projbuild
```kconfig
menu "Mosaico Webcam"
    config WEBCAM_STATIC_FRAME
        bool "M1 USB bring-up with a static black JPEG"
        default n
        help
            Keep the camera powered down and send valid VGA black frames.
    config WEBCAM_ROTATION
        int "Default USB video rotation in degrees (0, 90, 180, 270)"
        range 0 270
        default 0
        help
            Uses the sensor's landscape orientation by default.
            Local preview compensates this rotation to follow device orientation.
            Used when no saved rotation exists; adjustable from Settings at runtime.
    config WEBCAM_SENSOR_MIRROR_Y
        bool "Sensor mounting correction: vertical mirror"
        default y
    config WEBCAM_SENSOR_MIRROR_X
        bool "Sensor mounting correction: horizontal mirror"
        default y
        help
            Correct the SC101IOT module's horizontally reversed output.
            Applied after rotation to both USB video and local preview.
    config WEBCAM_DIAGNOSTICS
        bool "Log pipeline statistics every five seconds over UART"
        default y
endmenu
```

## sdkconfig.defaults
```kconfig
CONFIG_IDF_TARGET="esp32s31"
CONFIG_IDF_EXPERIMENTAL_FEATURES=y
CONFIG_COMPILER_OPTIMIZATION_PERF=y
CONFIG_FREERTOS_HZ=1000
CONFIG_WEBCAM_ROTATION=0
CONFIG_WEBCAM_SENSOR_MIRROR_X=y

# GPIO33 is camera D2 and shares the USB Serial/JTAG D- pad.
CONFIG_ESP_CONSOLE_UART_DEFAULT=y
# CONFIG_ESP_CONSOLE_USB_SERIAL_JTAG is not set
# CONFIG_ESP_CONSOLE_SECONDARY_USB_SERIAL_JTAG is not set
CONFIG_ESP_CONSOLE_SECONDARY_NONE=y
# CONFIG_USJ_ENABLE_USB_SERIAL_JTAG is not set

CONFIG_SPIRAM=y
CONFIG_SPIRAM_MODE_OCT=y
CONFIG_SPIRAM_SPEED_250M=y
CONFIG_SPIRAM_MEMTEST=n
CONFIG_SPIRAM_MALLOC_ALWAYSINTERNAL=4096
CONFIG_SPIRAM_ALLOW_BSS_SEG_EXTERNAL_MEMORY=y
CONFIG_SPIRAM_ALLOW_NOINIT_SEG_EXTERNAL_MEMORY=y

CONFIG_MOSAICO_MODULE_CAMERA=y
CONFIG_CAMERA_OV3640=y
CONFIG_CAMERA_OV3640_AUTO_DETECT_DVP_INTERFACE_SENSOR=y
CONFIG_CAMERA_OV3640_DVP_YUV422_UYVY_1024X768_25FPS=y
CONFIG_CAMERA_OV3640_DVP_DEFAULT_FMT_YUV422_UYVY_1024X768_25FPS=y
CONFIG_CAMERA_SC101IOT_DVP_YUV422_1280X720_25FPS=y
CONFIG_CAMERA_SC101IOT_DVP_DEFAULT_FMT_YUV422_1280X720_25FPS=y

CONFIG_ESP_VIDEO_ENABLE_DVP_VIDEO_DEVICE=y

CONFIG_ESPTOOLPY_FLASHSIZE_16MB=y
CONFIG_ESPTOOLPY_FLASHMODE_QIO=y
# Confirm installation only after the webcam startup sequence succeeds.
CONFIG_BOOTLOADER_APP_ROLLBACK=y
CONFIG_BOOTLOADER_APP_ROLLBACK_CONFIRM_BY_APP=y
CONFIG_BOOTLOADER_LOG_LEVEL_ERROR=y

CONFIG_PARTITION_TABLE_CUSTOM=y
CONFIG_PARTITION_TABLE_CUSTOM_FILENAME="partitions.csv"

CONFIG_LV_FONT_MONTSERRAT_20=y
CONFIG_LV_DEF_REFR_PERIOD=16
# CONFIG_BSP_DISPLAY_LVGL_ENABLE is not set

CONFIG_TINYUSB_RHPORT_HS=y
CONFIG_FORMAT_MJPEG_CAM1=y
CONFIG_UVC_MODE_ISOC_CAM1=y
CONFIG_FRAMESIZE_VGA=y
CONFIG_UVC_CAM1_FRAMERATE=25
# CONFIG_UVC_CAM1_MULTI_FRAMESIZE is not set
CONFIG_TUSB_PRODUCT="Mosaico Webcam"
CONFIG_UVC_TINYUSB_TASK_PRIORITY=7
CONFIG_UVC_CAM1_TASK_PRIORITY=6
CONFIG_UVC_TINYUSB_TASK_CORE=0
CONFIG_UVC_CAM1_TASK_CORE=0
CONFIG_ESP_MAIN_TASK_STACK_SIZE=8192
```
